## W/shmsockproxy/drivers/char/ivshmem/Kconfig
```kconfig
# Copyright 2022-2024 TII (SSRC) and the Ghaf contributors
# SPDX-License-Identifier: Apache-2.0

config KVM_IVSHMEM_VM_COUNT
	int "Application VMs count"
	default 5
```

## modules/reference/hardware/jetpack/nvidia-jetson-orin/virtualization/common/bpmp-virt-common/sources/drivers/firmware/tegra/bpmp-guest-proxy/Kconfig
```kconfig
config TEGRA_BPMP_GUEST_PROXY
	bool "Tegra BPMP guest proxy driver"
	depends on TEGRA_BPMP
	help
	The Tegra BPMP guest proxy driver, virtualize the BPMP transfer
	function, allowing the guest to have access to the host BPMP.

	Say Y here to enable this driver and to compile this driver as a module, 
	choose M here. If unsure, say N
```

## modules/reference/hardware/jetpack/nvidia-jetson-orin/virtualization/common/bpmp-virt-common/sources/drivers/firmware/tegra/bpmp-host-proxy/Kconfig
```kconfig
config TEGRA_BPMP_HOST_PROXY
    depends on TEGRA_BPMP
	bool "Tegra BPMP host proxy support"
	help
	  Exposes the BPMP capabilities to the user level, in order to support the 
	  BPMP dependent devices passthrough to the virtual machines.

	  Say Y here to enable this driver and to compile this driver as a module, 
	  choose M here. If unsure, say N
```
