// SPDX-License-Identifier: GPL-2.0-only
// SPDX-FileCopyrightText: 2026 TII (SSRC) and the Ghaf contributors

#include <dt-bindings/clock/tegra234-clock.h>
#include <dt-bindings/reset/tegra234-reset.h>
#include <dt-bindings/memory/tegra234-mc.h>
#include <dt-bindings/interrupt-controller/irq.h>
#include <dt-bindings/interrupt-controller/arm-gic.h>
#include <dt-bindings/power/tegra234-powergate.h>

/dts-v1/;
/plugin/;

/ {
	fragment@0 {
		target-path = "/";

		__overlay__ {
			// NVIDIA guest drivers use the root compatible to select Tegra234 data.
			compatible = "nvidia,tegra234";
		};
	};
};

// Crosvm supplies PSCI, CPUs, GIC, virtio, BPMP and DCE. Reuse only the
// NVIDIA memory, engine, display, dummy and board-DCB payloads.
#define GHAF_CROSVM_OVERLAY
#include "tegra234-gpuvm-memory.dtsi"
#include "tegra234-gpuvm-engines.dtsi"
#include "tegra234-gpuvm-display.dtsi"
#include "tegra234-gpuvm-dummies.dtsi"
