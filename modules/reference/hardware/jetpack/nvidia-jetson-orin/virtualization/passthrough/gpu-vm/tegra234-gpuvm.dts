// SPDX-License-Identifier: GPL-2.0-only
// SPDX-FileCopyrightText: Copyright (c) 2023, NVIDIA CORPORATION & AFFILIATES.  All rights reserved.

#include <dt-bindings/clock/tegra234-clock.h>
#include <dt-bindings/reset/tegra234-reset.h>
#include <dt-bindings/mailbox/tegra186-hsp.h>
#include <dt-bindings/memory/tegra234-mc.h>
#include <dt-bindings/interrupt-controller/irq.h>
#include <dt-bindings/interrupt-controller/arm-gic.h>
#include <dt-bindings/interrupt/tegra234-irq.h>
#include <dt-bindings/gpio/tegra234-gpio.h>
#include <dt-bindings/p2u/tegra234-p2u.h>
#include <dt-bindings/power/tegra234-powergate.h>
#include <dt-bindings/pinctrl/pinctrl-tegra.h>

/dts-v1/;

/ {
	interrupt-parent = <0x8005>;
	model = "linux,dummy-virt";
	#size-cells = <0x02>;
	#address-cells = <0x02>;

	// Some drivers need that the root node has this compatible property
	compatible = "nvidia,tegra234";

	aliases {
/* host1x phandle is undefined once the engines fragment drops the node. */
#ifndef EXP_DROP_HOST1X
		host1x = &host1x;
#endif
	};
};

#include "tegra234-gpuvm-base.dtsi"
#include "tegra234-gpuvm-memory.dtsi"
#include "tegra234-gpuvm-proxies.dtsi"
#include "tegra234-gpuvm-display.dtsi"
#include "tegra234-gpuvm-engines.dtsi"
#include "tegra234-gpuvm-dummies.dtsi"
