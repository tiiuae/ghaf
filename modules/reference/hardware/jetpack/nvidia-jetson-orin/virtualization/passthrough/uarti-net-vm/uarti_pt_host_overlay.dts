/*
 * Copyright 2022-2024 TII (SSRC) and the Ghaf contributors
 * SPDX-License-Identifier: CC-BY-SA-4.0
 */

/dts-v1/;
/plugin/;

#include <dt-bindings/memory/tegra234-mc.h>

/{
    overlay-name = "UARTI passthrough on host";
    compatible = "nvidia,p3701-0000";
    
    fragment@0 {
        target = <&uarti>;
        __overlay__ {
            compatible = "nvidia,dummy";
            iommus = <&smmu_niso0 TEGRA234_SID_PASSTHROUGH>;
            status = "okay";
            dma-coherent;
        };
    };
};