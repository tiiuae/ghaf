// SPDX-License-Identifier: GPL-2.0-only
// SPDX-FileCopyrightText: 2026 TII (SSRC) and the Ghaf contributors

#include <dt-bindings/clock/tegra234-clock.h>
#include <dt-bindings/reset/tegra234-reset.h>
#include <dt-bindings/memory/tegra234-mc.h>
#include <dt-bindings/interrupt-controller/irq.h>
#include <dt-bindings/interrupt-controller/arm-gic.h>
#include <dt-bindings/power/tegra234-powergate.h>

/dts-v1/;
/plugin/;

/ {
	fragment@0 {
		target-path = "/";

		__overlay__ {
			compatible = "nvidia,tegra234";
		};
	};
};

// Crosvm supplies PSCI, CPUs, GIC, virtio, BPMP and DCE. The display VM owns
// only its split RAM, scanout and display keyholes; GPU, host1x and media stay
// with gpu-vm.
#define GHAF_CROSVM_OVERLAY
#include "tegra234-dispvm-memory.dtsi"
#include "tegra234-gpuvm-display.dtsi"
#include "tegra234-gpuvm-dummies.dtsi"
