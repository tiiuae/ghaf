/dts-v1/;
/plugin/;

#include <dt-bindings/interrupt-controller/arm-gic.h>
#include <dt-bindings/clock/tegra234-clock.h>
#include <dt-bindings/reset/tegra234-reset.h>
#include <dt-bindings/power/tegra234-powergate.h>
#include <dt-bindings/memory/tegra234-mc.h>

&{/} {
	#address-cells = <0x02>;
	#size-cells = <0x02>;

	bpmp: bpmp {
		compatible = "nvidia,tegra-bpmp-virtio";
		#clock-cells = <1>;
		#reset-cells = <1>;
		#power-domain-cells = <1>;
		status = "okay";
	};

	mgbe0: ethernet@6800000 {
		compatible = "nvidia,tegra234-mgbe";
		reg = <0x0 0x06800000 0x0 0x10000>, /* HV base */
			<0x0 0x06810000 0x0 0x10000>, /* MGBE base */
			<0x0 0x068A0000 0x0 0x10000>; /* XPCS base */
		reg-names = "hypervisor", "mac", "xpcs";

		interrupts = <GIC_SPI 384 IRQ_TYPE_LEVEL_HIGH>,    /* common */
			<GIC_SPI 385 IRQ_TYPE_LEVEL_HIGH>,    /* vm0 */
			<GIC_SPI 386 IRQ_TYPE_LEVEL_HIGH>,    /* vm1 */
			<GIC_SPI 387 IRQ_TYPE_LEVEL_HIGH>,    /* vm2 */
			<GIC_SPI 388 IRQ_TYPE_LEVEL_HIGH>,    /* vm3 */
			<GIC_SPI 389 IRQ_TYPE_LEVEL_HIGH>;    /* vm4 */
		interrupt-names = "common", "vm0", "vm1", "vm2", "vm3", "vm4";

		clocks = <&bpmp TEGRA234_CLK_MGBE0_RX_INPUT_M>,
			<&bpmp TEGRA234_CLK_MGBE0_RX_PCS_M>,
			<&bpmp TEGRA234_CLK_MGBE0_RX_PCS_INPUT>,
			<&bpmp TEGRA234_CLK_MGBE0_RX_PCS>,
			<&bpmp TEGRA234_CLK_MGBE0_TX>,
			<&bpmp TEGRA234_CLK_MGBE0_TX_PCS>,
			<&bpmp TEGRA234_CLK_MGBE0_MAC_DIVIDER>,
			<&bpmp TEGRA234_CLK_MGBE0_MAC>,
			<&bpmp TEGRA234_CLK_MGBE0_EEE_PCS>,
			<&bpmp TEGRA234_CLK_MGBE0_APP>,
			<&bpmp TEGRA234_CLK_MGBE0_PTP_REF>,
			<&bpmp TEGRA234_CLK_MGBE0_MACSEC>,
			<&bpmp TEGRA234_CLK_MGBE0_RX_INPUT>;
		clock-names = "rx-input-m", "rx-pcs-m", "rx-pcs-input",
			"rx-pcs", "tx", "tx-pcs", "mac-divider",
			"mac", "eee-pcs", "mgbe", "ptp-ref",
			"mgbe_macsec", "rx-input";

		resets = <&bpmp TEGRA234_RESET_MGBE0_MAC>,
			<&bpmp TEGRA234_RESET_MGBE0_PCS>;
		reset-names = "mac", "pcs";

		power-domains = <&bpmp TEGRA234_POWER_DOMAIN_MGBEB>;

		//interconnects = <&mc TEGRA234_MEMORY_CLIENT_MGBEARD &emc>,
		//<&mc TEGRA234_MEMORY_CLIENT_MGBEAWR &emc>;
		//interconnect-names = "dma-mem", "write";
		//iommus = <&smmu_niso0 TEGRA234_SID_MGBE>;

		snps,axi-config = <&mgbe0_axi_setup>;

		phy-mode = "10gbase-r";
		//phy-handle = <&mgbe0_phy>;

		status = "okay";
		interrupt-parent = <&intc>;
		dma-coherent;

		mgbe0_axi_setup: stmmac-axi-config {
			snps,blen = <256 128 64 32 16 8 4>;
			snps,rd_osr_lmt = <63>;
			snps,wr_osr_lmt = <63>;
		};
	};
};
