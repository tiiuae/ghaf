/*
 * Copyright 2022-2024 TII (SSRC) and the Ghaf contributors
 * SPDX-License-Identifier: CC-BY-SA-4.0
 *
 * BPMP host-proxy allow-list. The proxy forwards a guest's clock/reset/power
 * requests to the real BPMP ONLY for the ids listed here (bpmp-host-proxy.c
 * gates MRQ_CLK, MRQ_RESET and MRQ_PG against these three properties);
 * everything else is refused.
 *
 * This is a safety boundary. A guest kernel that could reach arbitrary clocks
 * would switch off ones the host needs -- its eMMC controller among them -- and
 * wedge the host. Keep this list to exactly the resources of the devices
 * actually passed through. Do NOT widen it to "everything"; see
 * ghaf.hardware.nvidia.virtualization.bpmpAllowAllDomains.
 *
 * EXPECTED, and not a bug: the host proxy logs a stream of
 *   "bpmp-host: Warning, clock not allowed for: <id>, with command: <n>"
 * at guest boot. Those are the boundary working. The guest's clock framework
 * probes rates (command 1, CMD_CLK_GET_RATE) and re-enables parent PLLs
 * (command 7, CMD_CLK_ENABLE) that are already on at the host; both are refused
 * and neither is needed -- MGBE0's own clocks (below) are what the link uses,
 * and it comes up at 1Gbps regardless. The only casualty is PTP hardware
 * timestamping, which wants parent-clock rate control this list deliberately
 * withholds. Do not add the probed ids to "fix" the warnings: that reopens the
 * path to clocks the guest could later disable.
 */

/dts-v1/;
/plugin/;

/ {
    overlay-name = "BPMP host proxy allow-list";
    compatible = "nvidia,tegra234";

    fragment@0 {
        target-path = "/";
        __overlay__ {
            bpmp_host_proxy: bpmp_host_proxy {
                compatible = "nvidia,bpmp-host-proxy";

                /*
                 * MGBE0 (ethernet@6800000) clocks, as raw BPMP clock ids read
                 * from the device's live DT `clocks` property. Names, in order:
                 *   rx-input-m rx-pcs-m rx-pcs-input rx-pcs tx tx-pcs
                 *   mac-divider mac eee-pcs mgbe ptp-ref mgbe_macsec rx-input
                 * Raw ids, not TEGRA234_CLK_* macros: NVIDIA's shipped DT is not
                 * identical to mainline and the macro set has drifted.
                 */
                allowed-clocks = <357 361 369 373 374 375
                                  376 377 378 379 380 381 248>;

                /* MGBE0 resets: pcs (45), mac (46), macsec_ns (47). */
                allowed-resets = <45 46 47>;

                /* MGBE0 power domain: MGBEA (18). */
                allowed-power-domains = <18>;

                status = "okay";
            };
        };
    };
};
