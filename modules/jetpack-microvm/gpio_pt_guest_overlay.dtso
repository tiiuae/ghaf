/dts-v1/;
/plugin/;

/{
  overlay-name = "GPIO passthrough on guest";
  compatible = "nvidia,p3737-0000+p3701-0000\0nvidia,tegra234\0nvidia,tegra23x";

    fragment@0
    { target-path = "/";
        __overlay__
        {
            gpio: gpio {
                compatible = "nvidia,tegra234-bpmp";
                virtual-pa = <0x0 0x090c0000>;
                status = "okay";
            };
        };
    };
};
